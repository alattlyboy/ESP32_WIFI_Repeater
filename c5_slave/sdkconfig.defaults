## c5_slave/sdkconfig.defaults
```kconfig
# ESP32-C5 从机（协处理器）配置
# 目标是：一颗 C5 变成 SPI 网卡，WiFi 频段由主机下发

# ---- 角色：协处理器（CP）----
CONFIG_ESP_HOSTED=y
CONFIG_ESP_HOSTED_CP=y
CONFIG_ESP_HOSTED_CP_FOR_MCU=y
CONFIG_ESP_HOSTED_CP_RPC_V2=y

# ---- 传输：SPI 全双工 ----
CONFIG_EH_TRANSPORT_CP_SPI=y
CONFIG_EH_TRANSPORT_CP_SPI_MODE_3=y

# C5 侧引脚（与 S3 侧一一对应；与 Kconfig 默认值一致，写出来便于核对）
CONFIG_EH_TRANSPORT_CP_SPI_GPIO_CLK=3
CONFIG_EH_TRANSPORT_CP_SPI_GPIO_MOSI=7
CONFIG_EH_TRANSPORT_CP_SPI_GPIO_MISO=2
CONFIG_EH_TRANSPORT_CP_SPI_GPIO_CS=10
CONFIG_EH_TRANSPORT_CP_SPI_GPIO_HANDSHAKE=1
CONFIG_EH_TRANSPORT_CP_SPI_GPIO_DATA_READY=4

# ---- WiFi 打开（它就是那块网卡），蓝牙关掉省内存 ----
CONFIG_ESP_WIFI_ENABLED=y
CONFIG_ESP_HOSTED_CP_WIFI_ENABLED=y
# 必须显式打开：否则从机不会向主机上报 WiFi 能力，hosted 初始化会失败
CONFIG_ESP_HOSTED_CP_FEAT_WIFI=y
CONFIG_ESP_HOSTED_CP_FEAT_WIFI_READY=y
CONFIG_BT_ENABLED=n

# ---- Flash / 分区 ----
CONFIG_ESPTOOLPY_FLASHSIZE_4MB=y
CONFIG_PARTITION_TABLE_CUSTOM=y
CONFIG_PARTITION_TABLE_CUSTOM_FILENAME="partitions.csv"

# ---- 性能 ----
CONFIG_ESP_DEFAULT_CPU_FREQ_MHZ_240=y
CONFIG_FREERTOS_HZ=1000
CONFIG_COMPILER_OPTIMIZATION_PERF=y
CONFIG_ESP_WIFI_STATIC_RX_BUFFER_NUM=10
CONFIG_ESP_WIFI_DYNAMIC_RX_BUFFER_NUM=32
CONFIG_ESP_WIFI_DYNAMIC_TX_BUFFER_NUM=32
CONFIG_ESP_WIFI_AMPDU_TX_ENABLED=y
CONFIG_ESP_WIFI_TX_BA_WIN=16
CONFIG_ESP_WIFI_AMPDU_RX_ENABLED=y
CONFIG_ESP_WIFI_RX_BA_WIN=16
CONFIG_ESP_WIFI_RX_IRAM_OPT=y
CONFIG_ESP_WIFI_IRAM_OPT=y

# ---- 不需要网络分段特性 ----
CONFIG_ESP_HOSTED_CP_FEAT_NW_SPLIT=n

# ---- 企业版 802.1X（校园网 / WPA2-Enterprise）----
# 不开这个，主机调 enterprise_enable 会返回 ESP_ERR_NOT_SUPPORTED，
# 校园网连接就会停在 reason=210 / 202。
CONFIG_ESP_HOSTED_CP_FEAT_WIFI_EXT_ENT=y
CONFIG_ESP_WIFI_ENTERPRISE_SUPPORT=y
```
